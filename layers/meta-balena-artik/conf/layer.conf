## layers/meta-balena-artik/conf/layer.conf
```bitbake
BBPATH .= ":${LAYERDIR}"

BBFILES += "${LAYERDIR}/recipes-*/*/*.bb \
            ${LAYERDIR}/recipes-*/*/*.bbappend"

BBFILE_COLLECTIONS += "balena-artik"
BBFILE_PATTERN_balena-artik := "^${LAYERDIR}/"
BBFILE_PRIORITY_balena-artik = "1337"
```
